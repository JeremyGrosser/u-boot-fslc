## board/freescale/mx50kobo/Kconfig
```kconfig
if TARGET_MX50KOBO

config SYS_BOARD
	default "mx50kobo"

config SYS_VENDOR
	default "freescale"

config SYS_SOC
	default "mx5"

config SYS_CONFIG_NAME
	default "mx50kobo"

endif
```

## configs/mx50kobo_defconfig
```kconfig
CONFIG_ARM=y
CONFIG_TARGET_MX50KOBO=y
CONFIG_SYS_EXTRA_OPTIONS="IMX_CONFIG=board/freescale/mx50kobo/imximage.cfg"
# CONFIG_CMD_IMLS is not set
# CONFIG_CMD_SETEXPR is not set
```
